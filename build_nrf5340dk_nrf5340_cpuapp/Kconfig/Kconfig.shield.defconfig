## build_nrf5340dk_nrf5340_cpuapp/Kconfig/Kconfig.shield.defconfig
```kconfig
osource "C:/Users/pulcher/ncs/v1.5.0/nrf/boards/shields/*/Kconfig.defconfig"
osource "C:/Users/pulcher/ncs/v1.5.0/zephyr/boards/shields/*/Kconfig.defconfig"
osource "C:/Users/pulcher/ncs/v1.5.0/zephyr/boards/shields/*/Kconfig.defconfig"
```
