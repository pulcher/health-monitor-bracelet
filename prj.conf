## prj.conf
```kconfig
CONFIG_HEAP_MEM_POOL_SIZE=16384
CONFIG_MAIN_STACK_SIZE=4096

CONFIG_DISPLAY=y
CONFIG_DISPLAY_LOG_LEVEL_ERR=y

CONFIG_LOG=n

CONFIG_LVGL=y
CONFIG_LVGL_ANTIALIAS=y
CONFIG_LVGL_USE_LABEL=y
CONFIG_LVGL_USE_CONT=y
CONFIG_LVGL_USE_BTN=y
CONFIG_LVGL_USE_CHECKBOX=y
CONFIG_LVGL_USE_IMG=y
CONFIG_LVGL_USE_THEME_MATERIAL=y
CONFIG_LVGL_USE_ANIMATION=y
CONFIG_LVGL_USE_SHADOW=y
CONFIG_EXTRA_EXCEPTION_INFO=y

CONFIG_NEWLIB_LIBC=y

CONFIG_BT=y
CONFIG_BT_PERIPHERAL=y
CONFIG_BT_DEVICE_NAME="Nordic_Blinky"

# Enable the LBS service
CONFIG_BT_LBS=y

# Enable I2C
CONFIG_I2C=y
CONFIG_I2C_1=y
CONFIG_I2C_NRFX=y
```

## src/main.c
```c
/*
 * Copyright (c) 2018 Jan Van Winkel <jan.van_winkel@dxplore.eu>
 *
 * SPDX-License-Identifier: Apache-2.0
 */

#include <device.h>
#include <drivers/display.h>
#include <lvgl.h>
#include <stdio.h>
#include <string.h>
#include <zephyr.h>
#include "gui.h"
#include "app_ble.h"
#include <drivers/i2c.h>
#include "max30102.h"

#define CONFIG_EXTRA_EXCEPTION_INFO
#define LOG_LEVEL CONFIG_LOG_DEFAULT_LEVEL
#include <logging/log.h>
LOG_MODULE_REGISTER(app);

#define I2C_DEV "I2C_1"

static void on_app_ble_event(app_ble_event_data_t * evt_data)
{
	switch(evt_data->type) {
		case APP_BLE_CONNECTED:
			printk("Connected\n");
			gui_set_bt_state(GUI_BT_STATE_CONNECTED);
			break;

		case APP_BLE_DISCONNECTED:
			printk("Disconnected\n");
			gui_set_bt_state(GUI_BT_STATE_ADVERTISING);

			app_ble_start_advertising();
			break;

		case APP_BLE_ON_LED_WRITE:
			printk("Led %s\n", evt_data->led_state ? "On" : "Off");
			gui_set_bt_led_state(evt_data->led_state);
			break;
	}
}

void on_gui_event(gui_event_t *event)
{
	switch(event->evt_type) {
		case GUI_EVT_BUTTON_PRESSED:
			app_ble_send_button_state(event->button_checked);
			break;
	}
}

void main(void)
{
    const struct device *i2c_dev;
	uint8_t cmp_data[16];
	uint8_t data[16];
	int i, ret;

	i2c_dev = device_get_binding(I2C_DEV);
	if (!i2c_dev) {
		printk("I2C: Device driver not found.\n");
		return;
	}
/*
	if (!is_max30102_available(i2c_dev)) {
		printk("I2C: MAX30102 not found.\n");
		return;          
	}

  	if (get_max30102_part_id(i2c_dev) != MAX30102_EXPECTED_PARTID) {
          printk("not expected partid");
          return;
  	}

	max30102_softReset(i2c_dev);
        printk("Located MAX30102...\n");

        //Set reasonably to make sure there is clear sawtooth figure on the serial plotter
        /*!
         *@brief Use macro definition to configure sensor 
         *@param ledBrightness LED brightness, default value: 0x1F（6.4mA), Range: 0~255（0=Off, 255=50mA）
         *@param sampleAverage Average multiple samples then draw once, reduce data throughput, default 4 samples average
         *@param ledMode LED mode, default to use red light and IR at the same time
         *@param sampleRate Sampling rate, default 400 samples every second
         *@param pulseWidth Pulse width: the longer the pulse width, the wider the detection range. Default to be Max range
         *@param adcRange Measurement Range, default 4096 (nA), 15.63(pA) per LSB
         */
     /*   max30102_sensorConfiguration(i2c_dev, 60, SAMPLEAVG_8, \
                                        MODE_MULTILED, SAMPLERATE_400, \
                                        PULSEWIDTH_411, ADCRANGE_16384);

	/* printk("Cionfigured MAX30102...\n");

        */
	uint8_t error = 0u;

	i2c_configure(i2c_dev, I2C_SPEED_SET(I2C_SPEED_STANDARD));

	gui_config_t gui_config = {.event_callback = on_gui_event};
	gui_init(&gui_config);

	app_ble_config_t app_ble_config = {.event_callback = on_app_ble_event};
	app_ble_init(&app_ble_config);

	app_ble_start_advertising();

	printk("pulcher Advertising started\n");

	gui_set_bt_state(GUI_BT_STATE_ADVERTISING);

	while (1) {
		uint8_t error;
		int nDevices;

		printk("Scanning...\n");

		//max30102_getIR(i2c_dev);

		k_sleep(K_MSEC(3000));
	}
}
```

## src/DFRobot_MAX30102.h
```c
/*!
 * @file DFRobot_MAX30102.h
 * @brief Define the basic structure of class DFRobot_MAX30102
 * @n This is a library used to drive heart rate and oximeter sensor
 * @n Function: freely control sensor, collect readings of red light and IR, algorithms for heart-rate and SPO2
 * @copyright   Copyright (c) 2010 DFRobot Co.Ltd (http://www.dfrobot.com)
 * @licence     The MIT License (MIT)
 * @author [YeHangYu](hangyu.ye@dfrobot.com)
 * @version  V1.0
 * @date  2020-05-30
 * @https://github.com/DFRobot/DFRobot_MAX30102
 */
#ifndef _DFROBOT_MAX30102_H
#define _DFROBOT_MAX30102_H

//#include <Arduino.h>
//#include <Wire.h>
#include "SPO2/algorithm.h"
#include "PBA/heartRate.h"

//Open this macro to see the detailed running process of the program
// #define ENABLE_DBG

#ifdef ENABLE_DBG
#define DBG(...) {Serial.print("[");Serial.print(__FUNCTION__); Serial.print("(): "); Serial.print(__LINE__); Serial.print(" ] "); Serial.println(__VA_ARGS__);}
#else
#define DBG(...)
#endif

#define MAX30102_IIC_ADDRESS  0x57 //I2C Address

//Status Registers
#define MAX30102_INTSTAT1        0x00//Interrupt Status1
#define MAX30102_INTSTAT2        0x01//Interrupt Status2
#define MAX30102_INTENABLE1      0x02//Interrupt Enable1
#define MAX30102_INTENABLE2      0x03//Interrupt Enable2
//FIFO Registers
#define MAX30102_FIFOWRITEPTR    0x04//FIFO Write Pointer, The FIFO Write Pointer points to the location where the MAX30102 writes the next sample. This pointer advances for each sample pushed on to the FIFO. It can also be changed through the I2C interface when MODE[2:0] is 010, 011, or 111.
#define MAX30102_FIFOOVERFLOW    0x05//FIFO Overflow Counter, When the FIFO is full, samples are not pushed on to the FIFO, samples are lost. OVF_COUNTER counts the number of samples lost. It saturates at 0x1F. When a complete sample is “popped” (i.e., removal of old FIFO data and shifting the samples down) from the FIFO (when the read pointer advances), OVF_COUNTER is reset to zero.
#define MAX30102_FIFOREADPTR     0x06//FIFO Read Pointer, The FIFO Read Pointer points to the location from where the processor gets the next sample from the FIFO through the I2C interface. This advances each time a sample is popped from the FIFO. The processor can also write to this pointer after reading the samples to allow rereading samples from the FIFO if there is a data communication error.
#define MAX30102_FIFODATA        0x07//FIFO Data Register, The circular FIFO depth is 32 and can hold up to 32 samples of data. The sample size depends on the number of LED channels (a.k.a. channels) configured as active. As each channel signal is stored as a 3-byte data signal, the FIFO width can be 3 bytes or 6 bytes in size.
//Configuration Registers
#define MAX30102_FIFOCONFIG      0x08//FIFO Configuration
#define MAX30102_MODECONFIG      0x09//Mode Configuration
#define MAX30102_PARTICLECONFIG  0x0A//SpO2 Configuration
#define MAX30102_LED1_PULSEAMP   0x0C//LED1 Pulse Amplitude
#define MAX30102_LED2_PULSEAMP   0x0D//LED2 Pulse Amplitude
#define MAX30102_LED3_PULSEAMP   0x0E//RESERVED
#define MAX30102_LED_PROX_AMP    0x10//RESERVED
#define MAX30102_MULTILEDCONFIG1 0x11//Multi-LED Mode Control Registers
#define MAX30102_MULTILEDCONFIG2 0x12//Multi-LED Mode Control Registers
//Die Temperature Registers
#define MAX30102_DIETEMPINT      0x1F//Die Temp Integer
#define MAX30102_DIETEMPFRAC     0x20//Die Temp Fraction
#define MAX30102_DIETEMPCONFIG   0x21//Die Temperature Config
#define MAX30102_PROXINTTHRESH   0x30//RESERVED
//Part ID Registers
#define MAX30102_REVISIONID      0xFE//Revision ID
#define MAX30102_PARTID          0xFF//Part ID:0x15
#define MAX30102_EXPECTED_PARTID  0x15

//Circular buffer for storing sensor readings, cannot be smaller than 2 
#if defined(__AVR_ATmega328P__) || defined(__AVR_ATmega168__)
#define MAX30102_SENSE_BUF_SIZE  2
#else
#define MAX30102_SENSE_BUF_SIZE  30
#endif


//class DFRobot_MAX30102
//{
//Configuration Options 
//FIFO Configuration(Register address 0x08)
//sampleAverage(Table 3. Sample Averaging)
#define SAMPLEAVG_1     0
#define SAMPLEAVG_2     1
#define SAMPLEAVG_4     2
#define SAMPLEAVG_8     3
#define SAMPLEAVG_16    4
#define SAMPLEAVG_32    5

//Mode configuration(Register address 0x09)
//ledMode(Table 4. Mode Control)
#define MODE_REDONLY    2
#define MODE_RED_IR     3
#define MODE_MULTILED   7

//Particle sensing configuration(Register address 0x0A)
//adcRange(Table 5. SpO2 ADC Range Control)
#define ADCRANGE_2048   0
#define ADCRANGE_4096   1
#define ADCRANGE_8192   2
#define ADCRANGE_16384  3
//sampleRate(Table 6. SpO2 Sample Rate Control)
#define SAMPLERATE_50   0 
#define SAMPLERATE_100  1
#define SAMPLERATE_200  2
#define SAMPLERATE_400  3
#define SAMPLERATE_800  4
#define SAMPLERATE_1000 5
#define SAMPLERATE_1600 6
#define SAMPLERATE_3200 7
//pulseWidth(Table 7. LED Pulse Width Control)
#define PULSEWIDTH_69   0 
#define PULSEWIDTH_118  1
#define PULSEWIDTH_215  2
#define PULSEWIDTH_411  3

//Multi-LED Mode Control Registers(Register address 0x011)
#define SLOT_NONE       0
#define SLOT_RED_LED    1
#define SLOT_IR_LED     2

//public:
  /*
    Interrupt Status(0x00–0x01) (pg 12)
    * ------------------------------------------------------------------------------------------
    * |    b7    |    b6    |    b5    |    b4    |    b3    |    b2    |    b1     |    b0    |
    * ------------------------------------------------------------------------------------------
    * |  A_FULL  | PPG_RDY  |  ALC_OVF |                    NONE                    | PWR_RDY  |
    * ------------------------------------------------------------------------------------------
    * ------------------------------------------------------------------------------------------
    * |    b7    |    b6    |    b5    |    b4    |    b3    |    b2   |     b1     |    b0    |
    * ------------------------------------------------------------------------------------------
    * |                           NONE                                 |DIE_TEMP_RDY|   NONE   |
    * ------------------------------------------------------------------------------------------
  */
  /*
    Interrupt Enable(0x02–0x03) (pg 13)
    * ------------------------------------------------------------------------------------------
    * |    b7    |    b6    |    b5    |    b4    |    b3    |    b2    |    b1     |    b0    |
    * ------------------------------------------------------------------------------------------
    * |A_FULL_EN |PPG_RDY_EN|ALC_OVF_EN|                         NONE                          |
    * ------------------------------------------------------------------------------------------
    * ------------------------------------------------------------------------------------------
    * |    b7    |    b6    |    b5    |    b4    |    b3    |    b2   |       b1      |   b0  |
    * ------------------------------------------------------------------------------------------
    * |                           NONE                                 |DIE_TEMP_RDY_EN|  NONE |
    * ------------------------------------------------------------------------------------------
  */
  typedef struct {
    uint8_t   NONE:1;
    uint8_t   dieTemp:1;     // Internal Temperature Ready Flag
    uint8_t   NONE1:6;
    uint8_t   NONE2:5;
    uint8_t   ALCOverflow:1; // Ambient Light Cancellation Overflow
    uint8_t   dataReady:1;   // New FIFO Data Ready
    uint8_t   almostFull:1;  // FIFO Almost Full Flag
  } __attribute__ ((packed)) sEnable_t;
  /*
    FIFO Configuration(0x08) (pg 17)
    * ------------------------------------------------------------------------------------------
    * |    b7    |    b6    |    b5    |    b4          | b3 |    b2    |    b1     |    b0    |
    * ------------------------------------------------------------------------------------------
    * |            SMP_AVE             |FIFO_ROLLOVER_EN|               FIFO_A_FULL            |
    * ------------------------------------------------------------------------------------------
  */
  typedef struct {
    uint8_t   almostFull:4; // FIFO Almost Full Value
    uint8_t   RollOver:1;   // FIFO Rolls on Full
    uint8_t   sampleAverag:3;  // Sample Averaging
  } __attribute__ ((packed)) sFIFO_t;

  /*
    Mode configuration(0x09) (pg 18)
    * ------------------------------------------------------------------------------------------
    * |    b7    |    b6    |    b5    |    b4    |    b3    |    b2    |    b1     |    b0    |
    * ------------------------------------------------------------------------------------------
    * |   SHDN   |   RESET  |             NONE               |              MODE               |
    * ------------------------------------------------------------------------------------------
  */
  typedef struct {
    uint8_t   ledMode:6; /*!< 010:Heart Rate mode, Red only. 011:SpO2 mode, Red and IR. 111:Multi-LED mode, Red and IR*/
    uint8_t   reset:1; /*!< 1:reset */
    uint8_t   shutDown:1; /*!< 0: wake up 1: put IC into low power mode*/
  } __attribute__ ((packed)) sMode_t;

  /*
    Particle sensing configuration(0x0A) (pg 18)
    * ------------------------------------------------------------------------------------------
    * |    b7    |    b6    |    b5    |    b4    |    b3    |    b2    |    b1     |    b0    |
    * ------------------------------------------------------------------------------------------
    * |   NONE   |     SPO2_ADC_RGE    |             SPO2_SR            |        LED_PW        |
    * ------------------------------------------------------------------------------------------
  */
  typedef struct {
    uint8_t   pulseWidth:2;
    uint8_t   sampleRate:3;
    uint8_t   adcRange:3;
  } __attribute__ ((packed)) sParticle_t;

  /*
    LED Pulse Amplitude(0x0C–0x0D) (pg 20)
    * ------------------------------------------------------------------------------------------
    * |    b7    |    b6    |    b5    |    b4    |    b3    |    b2    |    b1     |    b0    |
    * ------------------------------------------------------------------------------------------
    * |                                         LED1_PA                                        |
    * ------------------------------------------------------------------------------------------
    * ------------------------------------------------------------------------------------------
    * |    b7    |    b6    |    b5    |    b4    |    b3    |    b2    |    b1     |    b0    |
    * ------------------------------------------------------------------------------------------
    * |                                         LED2_PA                                        |
    * ------------------------------------------------------------------------------------------
  */
  /*
    Multi-LED Mode Control Registers(0x011) (pg 21)
    * ------------------------------------------------------------------------------------------
    * |    b7    |    b6    |    b5    |    b4    |    b3    |    b2    |    b1     |    b0    |
    * ------------------------------------------------------------------------------------------
    * |   NONE   |              SLOT2             |   NONE   |             SLOT1               |
    * ------------------------------------------------------------------------------------------
  */
  typedef struct {
    uint8_t   SLOT1:4;
    uint8_t   SLOT2:4;
  } __attribute__ ((packed)) sMultiLED_t;

  /*!
   *@brief Circular buffer for storing samples 
   */
  typedef struct {
    uint32_t red[MAX30102_SENSE_BUF_SIZE];
    uint32_t IR[MAX30102_SENSE_BUF_SIZE];
    uint8_t head;
    uint8_t tail;
  } sSenseBuf_t;

//public:

  /*!
   *@brief Constructor 
   */
//  DFRobot_MAX30102(void);

  /*!
   *@brief Init sensor 
   *@param pWire IIC bus pointer object and construction device, can both pass or not pass parameters (Wire in default)
   *@param i2cAddr Chip IIC address (0x57 in default)
   *@return true or false
   */
//  bool begin(TwoWire *pWire = &Wire, uint8_t i2cAddr = MAX30102_IIC_ADDRESS);

  /*!
   *@brief Use macro definition to configure sensor 
   *@param ledBrightness LED brightness, default value: 0x1F（6.4mA), Range: 0~255（0=Off, 255=50mA）
   *@param sampleAverage Average multiple samples then draw once, reduce data throughput, default 4 samples average
   *@param ledMode LED mode, default to use red light and IR at the same time
   *@param sampleRate Sampling rate, default 400 samples every second
   *@param pulseWidth Pulse width: the longer the pulse width, the wider the detection range. Default to be Max range 
   *@param adcRange ADCMeasurement Range, default 4096 (nA)，15.63(pA) per LSB
   */
 // void sensorConfiguration(uint8_t ledBrightness = 0x1F, uint8_t sampleAverage = SAMPLEAVG_4, \
   //                        uint8_t ledMode = MODE_MULTILED, uint8_t sampleRate = SAMPLERATE_400, \
     //                      uint8_t pulseWidth = PULSEWIDTH_411, uint8_t adcRange = ADCRANGE_4096);

  
  /*!
   *@brief get red value
   *@return Red light reading
   */
 // uint32_t getRed(void);

  /*!
   *@brief Get IR value 
   *@return IR reading
   */
//  uint32_t getIR(void);

  /*!
   *@brief Get module temperature in unit °C
   *@return Float temperature
   */
//  float readTemperatureC();

  /*!
   *@brief  Get module temperature in unit ℉
   *@return Float temperature
   */
//  float readTemperatureF();

  /*!
   *@brief Calculate heart rate and SPO2 
   *@param *SPO2                  [out]Calculated SPO2
   *@param *SPO2Valid             [out]If the calculated SPO2 is valid, the value is 1
   *@param *heartRate             [out]Calculated heart-rate
   *@param *heartRateValid        [out]If the calculated heart-rate is valid, the value is 1
   */
//  void heartrateAndOxygenSaturation(int32_t* SPO2,int8_t* SPO2Valid,int32_t* heartRate,int8_t* heartRateValid);

//private:
  
  /*!
   *@brief Reset all configuration, threshold, and data regsiter. When reset completed, auto reset the reset bit
   */
//  void softReset();

  /*!
   *@brief Enter power-saving mode. In this mode, all registers keep their values, and read and write normally, clear all interrupts to 0. 
   */
//  void shutDown();

  /*!
   *@brief Wake-up mode, work normally 
   */
//  void wakeUp();

  /*!
   *@brief Set LED mode 
   *@param mode Configure the mode by the macro definition with LEDMode comment 
   */
//  void setLEDMode(uint8_t mode);
  
  /*!
   *@brief Set ADC measurement range, default 4096 (nA)，15.63(pA) per LSB
   *@param adcRange Configure ADC measuring range by the macro definition with adcRange comment
   */
//  void setADCRange(uint8_t adcRange);

  /*!
   *@brief Set sampling rate 
   *@param sampleRate Configure sampling rate by the macro definition with sampleRate comment 
   */
//  void setSampleRate(uint8_t sampleRate);

  /*!
   *@brief Set pulse width, the longer the pulse width, the wider the detection range 
   *@param pulseWidth Configure pulse width by the macro defintion with pulseWidth comment
   */
//  void setPulseWidth(uint8_t pulseWidth);

  /*!
   *@brief Set brightness of red light 
   *@param amplitude Amplitude: 0x00 = 0mA, 0x7F = 25.4mA, 0xFF = 50mA
   */
//  void setPulseAmplitudeRed(uint8_t amplitude);

  /*!
   *@brief Set IR brightness 
   *@param amplitude Amplitude: 0x00 = 0mA, 0x7F = 25.4mA, 0xFF = 50mA
   */
//  void setPulseAmplitudeIR(uint8_t amplitude);

  /*!
   *@brief Configure led device according to the given number, 4 timeslot in total. We will only use slot1 and slot2. There are red light and IR light 
   *@param slotNumber Slot Number, can be 1, 2
   *@param device LED Device name：SLOT_RED_LED or SLOT_IR_LED
   */
//  void enableSlot(uint8_t slotNumber, uint8_t device);

  /*!
   *@brief Disable all slots 
   */
//  void disableAllSlots(void);

  /*!
   *@brief Enable FIFO Almost Full Flag. This interrupt is triggered when FIFO write pointer has a certian amount of free space.
   */
//  void enableAlmostFull(void);

  /*!
   *@brief Disable FIFO Almost Full Flag
   */
//  void disableAlmostFull(void);

  /*!
   *@brief Enable New FIFO Data Ready. This interrupt is triggered when there is a new sample in data FIFO
   */
  void enableDataReady(void);

  /*!
   *@brief Disable New FIFO Data Ready
   */
//  void disableDataReady(void);

  /*!
   *@brief Enable Ambient Light Cancellation Overflow. This interrupt is triggered when the ambient light cancellation function of SpO2/HR photodiode reaches the maximum
   */
//  void enableALCOverflow(void);

  /*!
   *@brief Disable Ambient Light Cancellation Overflow
   */
//  void disableALCOverflow(void);

  /*!
   *@brief Enable Internal Temperature Ready Flag. This interrupt is triggered when the internal mold temperature conversion is done.
   */
//  void enableDieTempReady(void);

  /*!
   *@brief Disable Internal Temperature Ready Flag
   */
//  void disableDieTempReady(void);

  /*!
   *@brief Set sample average. The sensor will send the average of multiple samples
   *@param samples Averaged sample. Configure it by the macro definition with the comment sampleAverage 
   */
//  void setFIFOAverage(uint8_t samples);

  /*!
   *@brief Enable FIFO Rolls on Full. If the FIFO is full, the FIFO address will return to 0 and FIFO will continue to fill in with new data.
   */
//  void enableFIFORollover();

  /*!
   *@brief Disable FIFO Rolls on Full. New sample will be lost if FIFO is full.
   */
//  void disableFIFORollover();

  /*!
   *@brief Specify the size of free space. After enabling interrupt, the "almost full" interrupt will be triggered when the set size is reached.
   *@param numberOfSamples The size of free sample space. Trigger the interrupt when free samples reached this value. 
   *@ If set to 2, the interrupt will be triggered by filling in 30 samples. If set to 0, that will be triggered in 32 samples.
   */
//  void setFIFOAlmostFull(uint8_t numberOfSamples);

  /*!
   *@brief Read chip ID
   */
//  uint8_t getPartID();

  /*!
   *@brief Get FIFO write pointer 
   *@return Write pointer 
   */
//  uint8_t getWritePointer(void);

  /*!
   *@brief Get FIFO read pointer 
   *@return Read pointer 
   */
//  uint8_t getReadPointer(void);

  /*!
   *@brief Reset FIFO
   */
//  void resetFIFO(void);

  /*!
   *@brief Read new data and save it in consctructor buffer 
   */
//  void getNewData(void);

//  void writeReg(uint8_t reg, const void* pBuf, uint8_t size);
//  uint8_t readReg(uint8_t reg, const void* pBuf, uint8_t size);

//private:
//  TwoWire *_pWire;
//  uint8_t _i2cAddr;
//  uint8_t _activeLEDs;
//  sSenseBuf_t senseBuf;//Buffer for storing multiple groups of array
//};

#endif
```

## src/app_ble.c
```c
#include "app_ble.h"
#include <zephyr/types.h>
#include <stdbool.h>
#include <stddef.h>
#include <string.h>
#include <errno.h>
#include <sys/printk.h>
#include <sys/byteorder.h>
#include <drivers/gpio.h>
#include <soc.h>

#include <bluetooth/bluetooth.h>
#include <bluetooth/hci.h>
#include <bluetooth/conn.h>
#include <bluetooth/uuid.h>
#include <bluetooth/gatt.h>

#include <bluetooth/services/lbs.h>

#define DEVICE_NAME             CONFIG_BT_DEVICE_NAME
#define DEVICE_NAME_LEN         (sizeof(DEVICE_NAME) - 1)

static app_ble_event_t m_event_callback = 0;
static app_ble_event_data_t m_event_data;

static bool app_bt_connected = false;
static bool app_button_state;

static const struct bt_data ad[] = {
	BT_DATA_BYTES(BT_DATA_FLAGS, (BT_LE_AD_GENERAL | BT_LE_AD_NO_BREDR)),
	BT_DATA(BT_DATA_NAME_COMPLETE, DEVICE_NAME, DEVICE_NAME_LEN),
};

static const struct bt_data sd[] = {
	BT_DATA_BYTES(BT_DATA_UUID128_ALL, BT_UUID_LBS_VAL),
};

static void trigger_event(app_ble_event_type_t event_type)
{
	if(m_event_callback)
	{
		m_event_data.type = event_type;
		m_event_callback(&m_event_data);
	}
}

static void connected(struct bt_conn *conn, uint8_t err)
{
	if (err) {
		printk("Connection failed (err %u)\n", err);
		return;
	}

	app_bt_connected = true;
	trigger_event(APP_BLE_CONNECTED);
}

static void disconnected(struct bt_conn *conn, uint8_t reason)
{
	app_bt_connected = false;
	trigger_event(APP_BLE_DISCONNECTED);
}

#ifdef CONFIG_BT_LBS_SECURITY_ENABLED
static void security_changed(struct bt_conn *conn, bt_security_t level,
			     enum bt_security_err err)
{
	char addr[BT_ADDR_LE_STR_LEN];

	bt_addr_le_to_str(bt_conn_get_dst(conn), addr, sizeof(addr));

	if (!err) {
		printk("Security changed: %s level %u\n", addr, level);
	} else {
		printk("Security failed: %s level %u err %d\n", addr, level,
			err);
	}
}
#endif

static struct bt_conn_cb conn_callbacks = {
	.connected        = connected,
	.disconnected     = disconnected,
#ifdef CONFIG_BT_LBS_SECURITY_ENABLED
	.security_changed = security_changed,
#endif
};

#if defined(CONFIG_BT_LBS_SECURITY_ENABLED)
static void auth_passkey_display(struct bt_conn *conn, unsigned int passkey)
{
	char addr[BT_ADDR_LE_STR_LEN];

	bt_addr_le_to_str(bt_conn_get_dst(conn), addr, sizeof(addr));

	printk("Passkey for %s: %06u\n", addr, passkey);
}

static void auth_cancel(struct bt_conn *conn)
{
	char addr[BT_ADDR_LE_STR_LEN];

	bt_addr_le_to_str(bt_conn_get_dst(conn), addr, sizeof(addr));

	printk("Pairing cancelled: %s\n", addr);
}

static void pairing_confirm(struct bt_conn *conn)
{
	char addr[BT_ADDR_LE_STR_LEN];

	bt_addr_le_to_str(bt_conn_get_dst(conn), addr, sizeof(addr));

	bt_conn_auth_pairing_confirm(conn);

	printk("Pairing confirmed: %s\n", addr);
}

static void pairing_complete(struct bt_conn *conn, bool bonded)
{
	char addr[BT_ADDR_LE_STR_LEN];

	bt_addr_le_to_str(bt_conn_get_dst(conn), addr, sizeof(addr));

	printk("Pairing completed: %s, bonded: %d\n", addr, bonded);
}

static void pairing_failed(struct bt_conn *conn, enum bt_security_err reason)
{
	char addr[BT_ADDR_LE_STR_LEN];

	bt_addr_le_to_str(bt_conn_get_dst(conn), addr, sizeof(addr));

	printk("Pairing failed conn: %s, reason %d\n", addr, reason);
}

static struct bt_conn_auth_cb conn_auth_callbacks = {
	.passkey_display = auth_passkey_display,
	.cancel = auth_cancel,
	.pairing_confirm = pairing_confirm,
	.pairing_complete = pairing_complete,
	.pairing_failed = pairing_failed
};
#else
static struct bt_conn_auth_cb conn_auth_callbacks;
#endif

static void app_led_cb(bool led_state)
{
	m_event_data.led_state = led_state;
	trigger_event(APP_BLE_ON_LED_WRITE);
}

static bool app_button_cb(void)
{
	return app_button_state;
}

static struct bt_lbs_cb lbs_callbacs = {
	.led_cb    = app_led_cb,
	.button_cb = app_button_cb,
};

void app_ble_start_advertising(void)
{
	int err = bt_le_adv_start(BT_LE_ADV_CONN, ad, ARRAY_SIZE(ad),
			      sd, ARRAY_SIZE(sd));
	if (err) {
		printk("Advertising failed to start (err %d)\n", err);
		return;
	}
}

void app_ble_send_button_state(bool btn_pressed)
{
	if(app_bt_connected) {
		bt_lbs_send_button_state(btn_pressed);
	}
}

void app_ble_init(app_ble_config_t * config)
{
	int err;

	m_event_callback = config->event_callback;

	bt_conn_cb_register(&conn_callbacks);
	if (IS_ENABLED(CONFIG_BT_LBS_SECURITY_ENABLED)) {
		bt_conn_auth_cb_register(&conn_auth_callbacks);
	}

	err = bt_enable(NULL);
	if (err) {
		printk("Bluetooth init failed (err %d)\n", err);
		return;
	}

	printk("Bluetooth initialized\n");

	err = bt_lbs_init(&lbs_callbacs);
	if (err) {
		printk("Failed to init LBS (err:%d)\n", err);
		return;
	}
}
```

## src/gui.c
```c
#include "gui.h"
#include <zephyr.h>
#include <device.h>
#include <drivers/display.h>
#include <lvgl.h>
#include <stdio.h>
#include <string.h>

#define LOG_LEVEL CONFIG_LOG_DEFAULT_LEVEL
#include <logging/log.h>
LOG_MODULE_REGISTER(gui);

uint32_t count = 0U;
char count_str[11] = {0};
const struct device *display_dev;

static gui_event_t m_gui_event;
static gui_callback_t m_gui_callback = 0;

// Create a message queue for handling external GUI commands
K_MSGQ_DEFINE(m_gui_cmd_queue, sizeof(gui_message_t), 8, 4);

// Define a timer to update the GUI periodically
static void on_gui_blink_timer(struct k_timer *dummy);
K_TIMER_DEFINE(gui_blink_timer, on_gui_blink_timer, NULL);

char *on_off_strings[2] = {"On", "Off"};

// GUI objects
lv_obj_t *top_header;
lv_obj_t *top_header_logo;
lv_obj_t *label_button, *label_led, *label_bt_state_hdr, *label_bt_state;
lv_obj_t *connected_background;
lv_obj_t *label_btn_state, *label_led_state;
lv_obj_t *btn1, *btn1_label;
lv_obj_t *checkbox_led;
lv_obj_t *image_led;
lv_obj_t *image_bg[12];

// Styles
lv_style_t style_btn, style_label, style_label_value, style_checkbox;
lv_style_t style_header, style_con_bg;

// Fonts
LV_FONT_DECLARE(arial_20bold);
LV_FONT_DECLARE(calibri_20b);
LV_FONT_DECLARE(calibri_20);
LV_FONT_DECLARE(calibri_24b);
LV_FONT_DECLARE(calibri_32b);

// Images
LV_IMG_DECLARE(nod_logo);
LV_IMG_DECLARE(led_on);
LV_IMG_DECLARE(led_off);
LV_IMG_DECLARE(img_noise_background);

static void gui_show_connected_elements(bool connected);

static void on_button1(lv_obj_t *btn, lv_event_t event)
{
	if(btn == btn1){
		if(event == LV_EVENT_PRESSED) {
			lv_label_set_text(label_btn_state, "Pressed");
			if(m_gui_callback) { 
				m_gui_event.evt_type = GUI_EVT_BUTTON_PRESSED;
				m_gui_event.button_checked = true;
				m_gui_callback(&m_gui_event);
			}
		}
		else if(event == LV_EVENT_RELEASED) {
			lv_label_set_text(label_btn_state, "Released");
			if(m_gui_callback) { 
				m_gui_event.evt_type = GUI_EVT_BUTTON_PRESSED;
				m_gui_event.button_checked = false;
				m_gui_callback(&m_gui_event);
			}
		}
	}
}

static void init_styles(void)
{
	/*Create background style*/
	static lv_style_t style_screen;
	lv_style_set_bg_color(&style_screen, LV_STATE_DEFAULT, LV_COLOR_MAKE(0xcb, 0xca, 0xff));
	lv_obj_add_style(lv_scr_act(), LV_BTN_PART_MAIN, &style_screen);

	/*Create the screen header label style*/
	lv_style_init(&style_header);
	lv_style_set_bg_opa(&style_header, LV_STATE_DEFAULT, LV_OPA_COVER);
	lv_style_set_bg_color(&style_header, LV_STATE_DEFAULT, LV_COLOR_MAKE(0x1C, 0x11, 0xFD));
	lv_style_set_radius(&style_header, LV_STATE_DEFAULT, 8);
	//lv_style_set_bg_grad_color(&style_header, LV_STATE_DEFAULT, LV_COLOR_TEAL);
	//lv_style_set_bg_grad_dir(&style_header, LV_STATE_DEFAULT, LV_GRAD_DIR_VER);
	lv_style_set_pad_left(&style_header, LV_STATE_DEFAULT, 70);
	lv_style_set_pad_top(&style_header, LV_STATE_DEFAULT, 30);
	lv_style_set_shadow_spread(&style_header, LV_STATE_DEFAULT, 1);
	lv_style_set_shadow_color(&style_header, LV_STATE_DEFAULT, LV_COLOR_BLACK);
	lv_style_set_shadow_opa(&style_header, LV_STATE_DEFAULT, 255);
	lv_style_set_shadow_width(&style_header, LV_STATE_DEFAULT, 1);
	lv_style_set_shadow_ofs_x(&style_header, LV_STATE_DEFAULT, 1);
	lv_style_set_shadow_ofs_y(&style_header, LV_STATE_DEFAULT, 2);
	lv_style_set_shadow_opa(&style_header, LV_STATE_DEFAULT, LV_OPA_50);

	/*Screen header text style*/
	lv_style_set_text_color(&style_header, LV_STATE_DEFAULT, LV_COLOR_MAKE(0x7d, 0xce, 0xfd));
	lv_style_set_text_font(&style_header, LV_STATE_DEFAULT, &calibri_32b);
	

	lv_style_init(&style_con_bg);
	lv_style_copy(&style_con_bg, &style_header);
	lv_style_set_bg_color(&style_con_bg, LV_STATE_DEFAULT, LV_COLOR_MAKE(0x69, 0xb0, 0x5a));
	lv_style_set_bg_opa(&style_con_bg, LV_STATE_DEFAULT, LV_OPA_50);
	lv_style_set_radius(&style_header, LV_STATE_DEFAULT, 4);
	
	/*Create a label style*/
	lv_style_init(&style_label);
	lv_style_set_bg_opa(&style_label, LV_STATE_DEFAULT, LV_OPA_COVER);
	lv_style_set_bg_color(&style_label, LV_STATE_DEFAULT, LV_COLOR_SILVER);
	lv_style_set_bg_grad_color(&style_label, LV_STATE_DEFAULT, LV_COLOR_GRAY);
	lv_style_set_bg_grad_dir(&style_label, LV_STATE_DEFAULT, LV_GRAD_DIR_VER);
	lv_style_set_pad_left(&style_label, LV_STATE_DEFAULT, 5);
	lv_style_set_pad_top(&style_label, LV_STATE_DEFAULT, 10);

	/*Add a border*/
	lv_style_set_border_color(&style_label, LV_STATE_DEFAULT, LV_COLOR_WHITE);
	lv_style_set_border_opa(&style_label, LV_STATE_DEFAULT, LV_OPA_70);
	lv_style_set_border_width(&style_label, LV_STATE_DEFAULT, 3);

	/*Set the text style*/
	lv_style_set_text_color(&style_label, LV_STATE_DEFAULT, LV_COLOR_MAKE(0x00, 0x00, 0x30));
	lv_style_set_text_font(&style_label, LV_STATE_DEFAULT, &calibri_20b);


	/*Create a label value style*/
	lv_style_init(&style_label_value);
	lv_style_set_bg_opa(&style_label_value, LV_STATE_DEFAULT, LV_OPA_20);
	lv_style_set_bg_color(&style_label_value, LV_STATE_DEFAULT, LV_COLOR_SILVER);
	lv_style_set_bg_grad_color(&style_label_value, LV_STATE_DEFAULT, LV_COLOR_TEAL);
	lv_style_set_bg_grad_dir(&style_label_value, LV_STATE_DEFAULT, LV_GRAD_DIR_VER);
	lv_style_set_pad_left(&style_label_value, LV_STATE_DEFAULT, 0);
	lv_style_set_pad_top(&style_label_value, LV_STATE_DEFAULT, 3);

	/*Set the text style*/
	lv_style_set_text_color(&style_label_value, LV_STATE_DEFAULT, LV_COLOR_MAKE(0x00, 0x00, 0x30));
	lv_style_set_text_font(&style_label_value, LV_STATE_DEFAULT, &calibri_20);


	/*Create a simple button style*/
	lv_style_init(&style_btn);
	lv_style_set_radius(&style_btn, LV_STATE_DEFAULT, 10);
	lv_style_set_bg_opa(&style_btn, LV_STATE_DEFAULT, LV_OPA_COVER);
	lv_style_set_bg_color(&style_btn, LV_STATE_DEFAULT, LV_COLOR_SILVER);
	lv_style_set_bg_grad_color(&style_btn, LV_STATE_DEFAULT, LV_COLOR_GRAY);
	lv_style_set_bg_grad_dir(&style_btn, LV_STATE_DEFAULT, LV_GRAD_DIR_VER);
	lv_style_set_shadow_spread(&style_btn, LV_STATE_DEFAULT, 1);
	lv_style_set_shadow_color(&style_btn, LV_STATE_DEFAULT, LV_COLOR_GRAY);
	lv_style_set_shadow_opa(&style_btn, LV_STATE_DEFAULT, 255);
	lv_style_set_shadow_width(&style_btn, LV_STATE_DEFAULT, 1);

	/*Swap the colors in pressed state*/
	lv_style_set_bg_color(&style_btn, LV_STATE_PRESSED, LV_COLOR_GRAY);
	lv_style_set_bg_grad_color(&style_btn, LV_STATE_PRESSED, LV_COLOR_SILVER);

	/*Add a border*/
	lv_style_set_border_color(&style_btn, LV_STATE_DEFAULT, LV_COLOR_BLACK);
	lv_style_set_border_opa(&style_btn, LV_STATE_DEFAULT, LV_OPA_70);
	lv_style_set_border_width(&style_btn, LV_STATE_DEFAULT, 3);

	/*Different border color in focused state*/
	lv_style_set_border_color(&style_btn, LV_STATE_FOCUSED, LV_COLOR_BLACK);
	lv_style_set_border_color(&style_btn, LV_STATE_FOCUSED | LV_STATE_PRESSED, LV_COLOR_NAVY);

	/*Set the text style*/
	lv_style_set_text_color(&style_btn, LV_STATE_DEFAULT, LV_COLOR_TEAL);
	lv_style_set_text_font(&style_btn, LV_STATE_DEFAULT, &calibri_24b);

	/*Make the button smaller when pressed*/
	lv_style_set_transform_height(&style_btn, LV_STATE_PRESSED, -4);
	lv_style_set_transform_width(&style_btn, LV_STATE_PRESSED, -8);
#if LV_USE_ANIMATION
	/*Add a transition to the size change*/
	static lv_anim_path_t path;
	lv_anim_path_init(&path);
	lv_anim_path_set_cb(&path, lv_anim_path_overshoot);

	lv_style_set_transition_prop_1(&style_btn, LV_STATE_DEFAULT, LV_STYLE_TRANSFORM_HEIGHT);
	lv_style_set_transition_prop_2(&style_btn, LV_STATE_DEFAULT, LV_STYLE_TRANSFORM_WIDTH);
	lv_style_set_transition_time(&style_btn, LV_STATE_DEFAULT, 300);
	lv_style_set_transition_path(&style_btn, LV_STATE_DEFAULT, &path);
#endif
}

static void init_blinky_gui(void)
{
	for(int i = 0; i < 12; i++){
		int x_index = i % 4;
		int y_index = i / 4;
		image_bg[i] = lv_img_create(lv_scr_act(), NULL);
		lv_obj_set_pos(image_bg[i], x_index*80, y_index*80);
		lv_obj_set_size(image_bg[i], 80, 80);
		lv_img_set_src(image_bg[i], &img_noise_background);		
	}

	// The connected header needs to be created before the top_header, to appear behind
	connected_background = lv_label_create(lv_scr_act(), NULL);
	lv_obj_add_style(connected_background, LV_LABEL_PART_MAIN, &style_con_bg);
	lv_label_set_long_mode(connected_background, LV_LABEL_LONG_DOT);
	lv_obj_set_pos(connected_background, 6, 65);
	lv_obj_set_size(connected_background, 308, 135);
	lv_label_set_text(connected_background, "");

	top_header = lv_label_create(lv_scr_act(), NULL);
	lv_obj_add_style(top_header, LV_LABEL_PART_MAIN, &style_header);
	lv_label_set_long_mode(top_header, LV_LABEL_LONG_DOT);
	lv_obj_set_pos(top_header, 3, 3);
	lv_obj_set_size(top_header, 314, 68);
	lv_label_set_text(top_header, "nRF Blinky");
	//lv_label_set_align(top_header, LV_LABEL_ALIGN_CENTER);

	top_header_logo = lv_img_create(lv_scr_act(), NULL);
	lv_obj_set_pos(top_header_logo, 0, 0);
	lv_obj_set_size(top_header_logo, 68, 68);
	lv_img_set_src(top_header_logo, &nod_logo);

	label_bt_state = lv_label_create(lv_scr_act(), NULL);
	lv_label_set_long_mode(label_bt_state, LV_LABEL_LONG_CROP);
	lv_label_set_align(label_bt_state, LV_LABEL_ALIGN_CENTER); 
	lv_obj_set_pos(label_bt_state, 70, 210);
	lv_obj_set_size(label_bt_state, 180, 30);
	lv_label_set_text(label_bt_state, "Idle");
	lv_obj_add_style(label_bt_state, LV_LABEL_PART_MAIN, &style_label_value);

	btn1 = lv_btn_create(lv_scr_act(), NULL);     /*Add a button the current screen*/
	lv_obj_set_pos(btn1, 10, 90);                            /*Set its position*/
	lv_obj_set_size(btn1, 120, 50);                          /*Set its size*/
	lv_obj_reset_style_list(btn1, LV_BTN_PART_MAIN);         /*Remove the styles coming from the theme*/
	lv_obj_add_style(btn1, LV_BTN_PART_MAIN, &style_btn);
	lv_btn_set_checkable(btn1, true);

	btn1_label = lv_label_create(btn1, NULL);          /*Add a label to the button*/
	lv_label_set_text(btn1_label, "Button");                     /*Set the labels text*/
	lv_obj_set_event_cb(btn1, on_button1);

	label_btn_state = lv_label_create(lv_scr_act(), NULL);
	lv_label_set_long_mode(label_btn_state, LV_LABEL_LONG_DOT);
	lv_obj_set_pos(label_btn_state, 10, 170);
	lv_obj_set_size(label_btn_state, 120, 25);
	lv_label_set_text(label_btn_state, "Released");
	lv_label_set_align(label_btn_state, LV_LABEL_ALIGN_CENTER);
	lv_obj_add_style(label_btn_state, LV_LABEL_PART_MAIN, &style_label_value);	

	image_led = lv_img_create(lv_scr_act(), NULL);
	lv_obj_set_pos(image_led, 192, 68);
	lv_obj_set_size(image_led, 68, 68);
	lv_img_set_src(image_led, &led_off);

	label_led_state = lv_label_create(lv_scr_act(), NULL);
	lv_label_set_long_mode(label_led_state, LV_LABEL_LONG_DOT);
	lv_obj_set_pos(label_led_state, 170, 170);
	lv_obj_set_size(label_led_state, 120, 25);
	lv_label_set_text(label_led_state, "Off");
	lv_label_set_align(label_led_state, LV_LABEL_ALIGN_CENTER);
	lv_obj_add_style(label_led_state, LV_LABEL_PART_MAIN, &style_label_value);

	gui_show_connected_elements(false);
}

static void gui_show_connected_elements(bool connected)
{
	lv_obj_set_hidden(connected_background, !connected);
	lv_obj_set_hidden(btn1, !connected);
	lv_obj_set_hidden(label_btn_state, !connected);
	lv_obj_set_hidden(image_led, !connected);
	lv_obj_set_hidden(label_led_state, !connected);
}

static void set_bt_state(gui_bt_state_t state)
{
	bool connected = false;
	switch(state){
		case GUI_BT_STATE_IDLE:
			k_timer_stop(&gui_blink_timer);
			lv_label_set_text(label_bt_state, "Idle");
			break;
		case GUI_BT_STATE_ADVERTISING:
			k_timer_start(&gui_blink_timer, K_MSEC(500), K_MSEC(500));
			lv_label_set_text(label_bt_state, "Advertising");
			break;
		case GUI_BT_STATE_CONNECTED:
			k_timer_stop(&gui_blink_timer);
			lv_label_set_text(label_bt_state, "Connected");
			connected = true;
			break;
	}
	gui_show_connected_elements(connected);
}

static void on_gui_blink_timer(struct k_timer *dummy)
{
	static bool blink_state;
	blink_state = !blink_state;
	lv_label_set_text(label_bt_state, blink_state ? "Advertising" : "");
}

void gui_init(gui_config_t * config)
{
	m_gui_callback = config->event_callback;
}

void gui_set_bt_state(gui_bt_state_t state)
{
	static gui_message_t set_bt_state_msg;
	set_bt_state_msg.type = GUI_MSG_SET_BT_STATE;
	set_bt_state_msg.params.bt_state = state;
	k_msgq_put(&m_gui_cmd_queue, &set_bt_state_msg, K_NO_WAIT);
}

void gui_set_bt_led_state(bool led_is_on)
{
	static gui_message_t set_led_state_msg;
	set_led_state_msg.type = GUI_MSG_SET_LED_STATE;
	set_led_state_msg.params.led_state = led_is_on;
	k_msgq_put(&m_gui_cmd_queue, &set_led_state_msg, K_NO_WAIT);
}

static void process_cmd_msg_queue(void)
{
	gui_message_t cmd_message;
	while(k_msgq_get(&m_gui_cmd_queue, &cmd_message, K_NO_WAIT) == 0){
		// Process incoming commands depending on type
		switch(cmd_message.type){
			case GUI_MSG_SET_STATE:
				break;
			case GUI_MSG_SET_BT_STATE:
				set_bt_state(cmd_message.params.bt_state);
				break;
			case GUI_MSG_SET_LED_STATE:
				lv_img_set_src(image_led, cmd_message.params.led_state ? &led_on : &led_off);
				lv_label_set_text(label_led_state, cmd_message.params.led_state ? "On" : "Off");
				break;
		}
	}
}

void gui_run(void)
{
	display_dev = device_get_binding(CONFIG_LVGL_DISPLAY_DEV_NAME);

	if (display_dev == NULL) {
		LOG_ERR("Display device not found!");
		return;
	}

	init_styles();

	init_blinky_gui();

	display_blanking_off(display_dev);

	while(1){
		process_cmd_msg_queue();
		lv_task_handler();
		k_sleep(K_MSEC(20));
	}
}

// Define our GUI thread, using a stack size of 4096 and a priority of 7
K_THREAD_DEFINE(gui_thread, 4096, gui_run, NULL, NULL, NULL, 7, 0, 0);
```

## src/gui.h
```c
#ifndef __GUI_H
#define __GUI_H

#include <zephyr.h>

typedef enum {GUI_EVT_BUTTON_PRESSED} gui_event_type_t;

typedef enum {GUI_BT_STATE_IDLE, GUI_BT_STATE_ADVERTISING, GUI_BT_STATE_CONNECTED} gui_bt_state_t;

typedef struct
{
	gui_event_type_t evt_type;
	bool button_checked;
} gui_event_t;

typedef enum  {GUI_MSG_SET_STATE, GUI_MSG_SET_BT_STATE, GUI_MSG_SET_LED_STATE} gui_msg_type_t;

typedef struct
{
	gui_msg_type_t type;
	void *p_data;
	union 
	{
		gui_bt_state_t bt_state;
		bool led_state;
	} params;
} gui_message_t;


typedef void (*gui_callback_t)(gui_event_t *event);

typedef struct
{
	gui_callback_t event_callback;
} gui_config_t;

void gui_init(gui_config_t * config);

void gui_update(void);

void gui_set_bt_state(gui_bt_state_t state);

void gui_set_bt_led_state(bool led_on);

#endif
```

## src/max30102.c
```c
/*
Driver for MAX30102
Coded specifically for the nRF5340DK
*/
#include <device.h>
#include <stdio.h>
#include <string.h>
#include <zephyr.h>
#include <drivers/i2c.h>
#include "max30102.h"

// to be private variables
struct i2c_msg msgs[1];
uint8_t dst = 1;
uint8_t error = -1;
uint8_t _activeLEDs;
sSenseBuf_t senseBuf;

bool is_max30102_available(struct device *i2c_dev) {

    msgs[0].buf = &dst;
    msgs[0].len = 1U;
    msgs[0].flags = I2C_MSG_WRITE | I2C_MSG_STOP;

    error = i2c_transfer(i2c_dev, &msgs[0], 1, MAX30102_IIC_ADDRESS);
    
    return error == 0;
}

uint8_t get_max30102_part_id(struct device *i2c_dev)
{
  uint8_t byteTemp, revisionId, error;
  error = max30102_write_read_reg(i2c_dev, MAX30102_PARTID, &byteTemp, 1);
  printk("Found part id: %x\n", byteTemp);

  error = max30102_write_read_reg(i2c_dev, MAX30102_REVISION_ID, &revisionId, 1);
  printk("Found revision id: %x\n", revisionId);
  return byteTemp;
}

void max30102_softReset(struct device *i2c_dev)
{
  sMode_t modeReg;
  max30102_readReg(i2c_dev, MAX30102_MODECONFIG, &modeReg, 1);
  modeReg.reset = 1;
  max30102_writeReg(i2c_dev, MAX30102_MODECONFIG, &modeReg, 1);
  uint32_t startTime = k_uptime_get();
  while (k_uptime_get() - startTime < 100) {
    max30102_readReg(i2c_dev, MAX30102_MODECONFIG, &modeReg, 1);
    if (modeReg.reset == 0) break; 
    k_sleep(K_MSEC(1));
  }
}

void max30102_sensorConfiguration(struct device *i2c_dev, uint8_t ledBrightness, uint8_t sampleAverage,
                                  uint8_t ledMode, uint8_t sampleRate, uint8_t pulseWidth,
                                  uint8_t adcRange)
{

  max30102_setFIFOAverage(i2c_dev, sampleAverage);

  max30102_setADCRange(i2c_dev, adcRange);

  max30102_setSampleRate(i2c_dev, sampleRate);

  max30102_setPulseWidth(i2c_dev, pulseWidth);

  max30102_setPulseAmplitudeRed(i2c_dev, ledBrightness);
  max30102_setPulseAmplitudeIR(i2c_dev, ledBrightness);

  max30102_enableSlot(i2c_dev, 1, SLOT_RED_LED);
  if (ledMode > MODE_REDONLY) max30102_enableSlot(i2c_dev, 2, SLOT_IR_LED);

  max30102_setLEDMode(i2c_dev, ledMode);

  if (ledMode == MODE_REDONLY) {
    _activeLEDs = 1;
  } else {
    _activeLEDs = 2;
  }

  max30102_enableFIFORollover(i2c_dev); 
  max30102_resetFIFO(i2c_dev); 
}

void max30102_setLEDMode(struct device *i2c_dev, uint8_t ledMode)
{
  sMode_t modeReg;
  max30102_write_read_reg(i2c_dev, MAX30102_MODECONFIG, &modeReg, 1);
  modeReg.ledMode = ledMode;
  max30102_writeReg(i2c_dev, MAX30102_MODECONFIG, &modeReg, 1);
}

void max30102_setFIFOAverage(struct device *i2c_dev, uint8_t numberOfSamples)
{
  sFIFO_t FIFOReg;
  max30102_readReg(i2c_dev, MAX30102_FIFOCONFIG, &FIFOReg, 1);
  FIFOReg.sampleAverag = numberOfSamples;
  max30102_writeReg(i2c_dev, MAX30102_FIFOCONFIG, &FIFOReg, 1);
}

void max30102_setADCRange(struct device *i2c_dev, uint8_t adcRange)
{
  sParticle_t particleReg;
  max30102_readReg(i2c_dev, MAX30102_PARTICLECONFIG, &particleReg, 1);
  particleReg.adcRange = adcRange;
  max30102_writeReg(i2c_dev, MAX30102_PARTICLECONFIG, &particleReg, 1);
}

void max30102_setSampleRate(struct device *i2c_dev, uint8_t sampleRate)
{
  sParticle_t particleReg;
  max30102_readReg(i2c_dev, MAX30102_PARTICLECONFIG, &particleReg, 1);
  particleReg.sampleRate = sampleRate;
  max30102_writeReg(i2c_dev, MAX30102_PARTICLECONFIG, &particleReg, 1);
}

void max30102_setPulseWidth(struct device *i2c_dev, uint8_t pulseWidth)
{
  sParticle_t particleReg;
  max30102_readReg(i2c_dev, MAX30102_PARTICLECONFIG, &particleReg, 1);
  particleReg.pulseWidth = pulseWidth;
  max30102_writeReg(i2c_dev, MAX30102_PARTICLECONFIG, &particleReg, 1);
}

void max30102_setPulseAmplitudeRed(struct device *i2c_dev, uint8_t amplitude)
{
  uint8_t byteTemp = amplitude;
  max30102_writeReg(i2c_dev, MAX30102_LED1_PULSEAMP, &byteTemp, 1);
}

void max30102_setPulseAmplitudeIR(struct device *i2c_dev, uint8_t amplitude)
{
  uint8_t byteTemp = amplitude;
  max30102_writeReg(i2c_dev, MAX30102_LED2_PULSEAMP, &byteTemp, 1);
}

void max30102_enableSlot(struct device *i2c_dev, uint8_t slotNumber, uint8_t device)
{
  sMultiLED_t multiLEDReg;
  switch (slotNumber) {
  case (1):
    max30102_readReg(i2c_dev, MAX30102_MULTILEDCONFIG1, &multiLEDReg, 1);
    multiLEDReg.SLOT1 = device;
    max30102_writeReg(i2c_dev, MAX30102_MULTILEDCONFIG1, &multiLEDReg, 1);
    break;
  case (2):
    max30102_readReg(i2c_dev, MAX30102_MULTILEDCONFIG1, &multiLEDReg, 1);
    multiLEDReg.SLOT2 = device;
    max30102_writeReg(i2c_dev, MAX30102_MULTILEDCONFIG1, &multiLEDReg, 1);
    break;
  default:
    break;
  }
}

void max30102_enableFIFORollover(struct device *i2c_dev)
{
  sFIFO_t FIFOReg;
  max30102_readReg(i2c_dev, MAX30102_FIFOCONFIG, &FIFOReg, 1);
  FIFOReg.RollOver = 1;
  max30102_writeReg(i2c_dev, MAX30102_FIFOCONFIG, &FIFOReg, 1);
}

void max30102_resetFIFO(struct device *i2c_dev)
{
  uint8_t byteTemp = 0;
  max30102_writeReg(i2c_dev, MAX30102_FIFOWRITEPTR, &byteTemp, 1);
  max30102_writeReg(i2c_dev, MAX30102_FIFOOVERFLOW, &byteTemp, 1);
  max30102_writeReg(i2c_dev, MAX30102_FIFOREADPTR, &byteTemp, 1);
}

uint8_t max30102_getWritePointer(struct device *i2c_dev)
{
  uint8_t byteTemp;
  max30102_readReg(i2c_dev, MAX30102_FIFOWRITEPTR, &byteTemp, 1);
  printk("max30102_getWritePointer: %d\n", byteTemp);
  return byteTemp;
}

uint8_t max30102_getReadPointer(struct device *i2c_dev)
{
  uint8_t byteTemp;
  max30102_readReg(i2c_dev, MAX30102_FIFOREADPTR, &byteTemp, 1);
  printk("max30102_getReadPointer: %d\n", byteTemp);
  return byteTemp;
}

// get info
uint32_t max30102_getIR(struct device *i2c_dev)
{
  max30102_getNewData(i2c_dev);
  return (senseBuf.IR[senseBuf.head]);
}

void max30102_getNewData(struct device *i2c_dev)
{
  int32_t numberOfSamples = 0;
  uint8_t readPointer = 0;
  uint8_t writePointer = 0;
  while (1) {
    readPointer = max30102_getReadPointer(i2c_dev);
    writePointer = max30102_getWritePointer(i2c_dev);

    if (readPointer == writePointer) {
      printk("...no data...");
    } else {
      numberOfSamples = writePointer - readPointer;
      if (numberOfSamples < 0) numberOfSamples += 32;
      int32_t bytesNeedToRead = numberOfSamples * _activeLEDs * 3;
   
        while (bytesNeedToRead > 0) {
          senseBuf.head++;
          senseBuf.head %= MAX30102_SENSE_BUF_SIZE;
          uint32_t tempBuf = 0;
          if (_activeLEDs > 1) { 
            uint8_t temp[6];
            uint8_t tempex;

            max30102_readReg(i2c_dev, MAX30102_FIFODATA, temp, 6);

            for(uint8_t i = 0; i < 3; i++){
              tempex = temp[i];
              temp[i] = temp[5-i];
              temp[5-i] = tempex;
            }

            memcpy(&tempBuf, temp, 3*sizeof(temp[0]));
            tempBuf &= 0x3FFFF;
            senseBuf.IR[senseBuf.head] = tempBuf;
            memcpy(&tempBuf, temp+3, 3*sizeof(temp[0]));
            tempBuf &= 0x3FFFF;
            senseBuf.red[senseBuf.head] = tempBuf;
          } else { 
            uint8_t temp[3];
            uint8_t tempex;

       
            max30102_readReg(i2c_dev, MAX30102_FIFODATA, temp, 3);
            tempex = temp[0];
            temp[0] = temp[2];
            temp[2] = tempex;

            memcpy(&tempBuf, temp, 3*sizeof(temp[0]));
            tempBuf &= 0x3FFFF;
            senseBuf.red[senseBuf.head] = tempBuf;
          }
          bytesNeedToRead -= _activeLEDs * 3;
        }
      return;
    }
    k_sleep(K_MSEC(1000));
  }
}


// Utilities
uint8_t max30102_readReg(struct device *i2c_dev, uint8_t reg, const void* pBuf, uint8_t size)
{
    return max30102_write_read_reg(i2c_dev, reg, pBuf, size);
}

int max30102_writeReg(struct device *i2c_dev, uint8_t reg, const void* pBuf, uint8_t size)
{
    return i2c_write(i2c_dev, pBuf, size, reg);
}


uint8_t max30102_write_read_reg(struct device *i2c_dev, uint8_t reg, void* pBuf, uint8_t size)
{
    int error;
    error = i2c_write_read(i2c_dev, MAX30102_IIC_ADDRESS, &reg, 1, pBuf, size);

    if (error) {
        printk("ERROR: couldn't communicate with max30102: %d", error);
    }

    return error;
}
```
